
/*이 파일 한 줄 요약 = linker.ld는 여러 .o 파일을 합치면서, 최종 커널의 시작 주소와 코드/데이터 배치 방법을 결정하는 파일*/

/*최종 커널의 시작점 = cpu가 커널로 넘어왔을 때 가장 먼저 실행할 함수다.*/
ENTRY(kernel_entry)

SECTIONS
{
    /*여기서  .은 현재 배치 주소를 의미한다. 즉 이제부터 나오는 코드와 데이터를 0x10000부터 배치하라는 의미다.*/
    . = 0x10000;

    /*text는 실행 코드 영역으로 이는 모든 obj파일들의 text를 모아서 kernel의 text에 넣으라는 뜻이다.*/
    .text :
    {
        *(.text)
    }
    /*읽기 전용 데이터 영역*/
    .rodata :
    {
        *(.rodata)
    }
    /*초기값이 있는 전역 변수가 들어있는 영역*/
    .data :
    {
        *(.data)
    }
    /*.bss는 초기값이 없거나 0으로 초기화되는 전역 변수가 들어가는 영역*/
    .bss :
    {
        *(.bss)
        *(COMMON)
    }
}